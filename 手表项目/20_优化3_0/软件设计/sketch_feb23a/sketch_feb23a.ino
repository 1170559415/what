#include <brzo_i2c.h>
#include "SSD1306Brzo.h"

SSD1306Brzo display(0x3c, D4, D3);

#include <FS.h>

int sleep_time = 10000;
unsigned long sleep1 = 0;
unsigned long sleep2 = 0;

//按键
#define Button_A D1
#define Button_B D2
#define Button_C D5
//检测按键
bool A = false;
bool B = false;
bool C = false;
bool Close_Button = true;
bool Open_Button = false;
void  ICACHE_RAM_ATTR Check_A();
void Check_A() {
  A = true;
}

void  ICACHE_RAM_ATTR Check_B();
void Check_B() {
  B = true;
}

void  ICACHE_RAM_ATTR Check_C();
void Check_C() {
  C = true;
}

void Check_Button() {
  if (Close_Button) {
    A = false;
    B = false;
    C = false;
    detachInterrupt(digitalPinToInterrupt(Button_A));
    detachInterrupt(digitalPinToInterrupt(Button_B));
    detachInterrupt(digitalPinToInterrupt(Button_C));

    sleep1 = millis() + sleep_time;
    Open_Button = true;
    Close_Button = false;
  }
  if (Open_Button && (sleep2 + sleep_time - 350 >= sleep1)) {
    attachInterrupt(digitalPinToInterrupt(Button_A), Check_A, FALLING);
    attachInterrupt(digitalPinToInterrupt(Button_B), Check_B, FALLING);
    attachInterrupt(digitalPinToInterrupt(Button_C), Check_C, FALLING);
    Open_Button = false;
  }
}


unsigned char Chinese[2][100];
unsigned char col[] = {   0x00, 0x00, 0x00, 0x00, 0x00, 0x00, 0x00, 0x00, 0x00, 0x00, 0x00, 0x00, 0x00, 0x00, 0x00, 0x00,
                          0x00, 0x00, 0x00, 0x00, 0x00, 0x00, 0x00, 0x41, 0x01, 0x00, 0x00, 0x00, 0x00, 0x00, 0x00, 0x00,
                          0x00, 0x00, 0x00, 0x00, 0x00, 0x00, 0x80, 0xC2, 0x02, 0x00, 0x00, 0x00, 0x00, 0x00, 0x00, 0x00,
                          0x00, 0x00, 0x00, 0x00, 0x00, 0x00, 0x50, 0x44, 0x04, 0x00, 0x00, 0x00, 0x00, 0x00, 0x00, 0x00,
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                          0x11, 0x11, 0x11, 0x11, 0x11, 0x11, 0x11, 0x11, 0x11, 0x11, 0x11, 0x11, 0x11, 0x11, 0x11, 0x11,
                      };

unsigned char arrow[] = {0x00, 0x00, 0x00, 0x00, 0x00, 0x00, 0x00, 0x00, 0x00, 0x01, 0xFA, 0x3E, 0x86, 0x3F, 0x42, 0x03,
                         0xBA, 0x02, 0xE2, 0x03, 0xFC, 0x01, 0x00, 0x00, 0x00, 0x00, 0x00, 0x00, 0x00, 0x00, 0x00, 0x00,
                        };

byte Interface = 0;
bool display_update = true;
bool main_Interface_open = true;
bool Recite_Word_open = false;
bool Recall_Word_open = false;
bool menu_open = false;
unsigned char file_bit[10];
void setup() {
  Serial.begin(9600);
  Serial.println();
  pinMode(D1, INPUT_PULLUP);
  pinMode(D2, INPUT_PULLUP);
  pinMode(D5, INPUT_PULLUP);
  SPIFFS.begin();
  display.init();
  display.flipScreenVertically();
  //  display.setContrast(20,255,0);

  display.setFont(Dialog_plain_12);
  display.drawString(0, 0, Word(256));
  //  Serial.println(Word(256));
  display_chinese(0, 13);
  display.display();
}


String Word(int open_word) {
  uint8_t book_bit[4];
  File book;
  unsigned char book_number = open_word / 200;
  int word_number = open_word % 200 - 1;
  book = SPIFFS.open("/" + (String)book_number + ".book" , "r");
  book.seek(word_number * 4 , SeekSet);
  book.read(book_bit, 4);
  int word_seek = (int)book_bit[0] * 128 + (int)book_bit[1];
  unsigned char English_long = book_bit[2];
  unsigned char Chinese_long = book_bit[3];
  Chinese[0][0] = Chinese_long;
  book.seek(word_seek, SeekSet);
  String English;
  for (English_long; English_long > 0; English_long--) {
    book.read(book_bit, 1);
    English += (char)book_bit[0];
  }
  for (Chinese_long; Chinese_long > 0; Chinese_long--) {
    book.read(book_bit, 2);
    Chinese[0][Chinese_long] = book_bit[0];
    Chinese[1][Chinese_long] = book_bit[1];
  }
  book.close();
  return English;
}

void display_chinese(char display_x_bak, char display_y_bak) {

  char horizontal = 0;
  char vertical = 0;
  int display_x = display_x_bak;
  int display_y = display_y_bak;
  int Chinese_bak;

  for (Chinese_bak = Chinese[0][0]; Chinese_bak > 0; Chinese_bak--) {
    switch (Chinese[0][Chinese_bak]) {
      case 1:
        display.setFont(Chinese_1);
        break;
      case 2:
        display.setFont(Chinese_2);
        break;
      case 3:
        display.setFont(Chinese_3);
        break;
      case 4:
        display.setFont(Chinese_4);
        break;
      case 5:
        display.setFont(Chinese_5);
        break;
      case 6:
        display.setFont(Chinese_6);
        break;
      case 7:
        display.setFont(Chinese_7);
        break;
      case 8:
        display.setFont(Chinese_8);
        break;
      case 9:
        display.setFont(Chinese_9);
        break;
      case 10:
        display.setFont(Chinese_10);
        break;
      case 11:
        display.setFont(Chinese_11);
        break;
      case 12:
        display.setFont(Chinese_12);
        break;
      case 13:
        display.setFont(Chinese_13);
        break;
      case 14:
        display.setFont(Chinese_14);
        break;
      case 15:
        display.setFont(Chinese_15);
        break;
      case 16:
        display.setFont(Chinese_16);
        break;
      case 17:
        display.setFont(Chinese_17);
        break;
      case 18:
        display.setFont(Chinese_18);
        break;
      case 19:
        display.setFont(Chinese_19);
        break;
      case 20:
        display.setFont(Chinese_20);
        break;
      case 21:
        display.setFont(Chinese_21);
        break;
      case 22:
        display.setFont(Chinese_22);
        break;
      case 23:
        display.setFont(Chinese_23);
        break;
      case 24:
        display.setFont(Chinese_24);
        break;
      case 25:
        display.setFont(Chinese_25);
        break;
      case 26:
        display.setFont(Chinese_26);
        break;
      case 27:
        display.setFont(Chinese_27);
        break;
      case 28:
        display.setFont(Chinese_28);
        break;
      case 29:
        display.setFont(Chinese_29);
        break;
      case 30:
        display.setFont(Chinese_30);
        break;
      case 31:
        display.setFont(Chinese_31);
        break;
      case 32:
        display.setFont(Chinese_32);
        break;
      case 33:
        display.setFont(Chinese_33);
        break;
      case 34:
        display.setFont(Chinese_34);
        break;
      case 35:
        display.setFont(Chinese_35);
        break;
      case 36:
        display.setFont(Chinese_36);
        break;
      case 37:
        display.setFont(Chinese_37);
        break;
      case 38:
        display.setFont(Chinese_38);
        break;
      default :
        display.setFont(Dialog_plain_12);
        break;
    }
    display.drawString(display_x + horizontal * 12 , display_y + vertical * 15 , String(char(Chinese[1][Chinese_bak])));
    display_x = display_x - (12 - display.getStringWidth(String(char(Chinese[1][Chinese_bak]))));
    horizontal++;
    if (display_x + (horizontal + 1) * 12 > 128) {
      horizontal = 0;
      display_x = display_x_bak;
      vertical++;
    }
  }
}
int id = 1;
int id_max = 50;
int id_min = 1;
void main_Interface() {
  if (main_Interface_open) {
    display.clear();
    display.drawXbm(0, 0, 128, 64, col);
    display.display();

    if ((C || B) && !Close_Button) {
      main_Interface_open = false;
      Recite_Word_open = true;
      id = id_min;
      Close_Button = true;
    }
    if (A && !Close_Button) {
      main_Interface_open = false;
      menu_open = true;
      Close_Button = true;
      Interface = 0;
    }
  }
}
unsigned char Recall_random_id[255];
bool Recall_Chinese = false;
void Recall_random_produce() {
  for (unsigned char random_num = 0; random_num <= (id_max - id_min); random_num++) {
    Recall_random_id[random_num] = random(0, id_max - id_min + 1);
    for (unsigned char random_num_num = 0; random_num_num < random_num; random_num_num++) {
      if (Recall_random_id[random_num] == Recall_random_id[random_num_num]) {
        random_num--;
        break;
      }
    }
  }
}
void Recall_Word() {
  if (Recall_Word_open) {
    File Recall_record;
    Recall_record = SPIFFS.open("/recall.book" , "r+");

    display.clear();
    if (!Recall_Chinese) {
      display.setFont(ArialMT_Plain_24);
      display.setTextAlignment(TEXT_ALIGN_CENTER);
      display.drawStringMaxWidth(64, 0, 120, Word(id_min + Recall_random_id[id]));
    }
    if (Recall_Chinese) {
      Recall_record.seek(5 + (id_min + Recall_random_id[id]) * 2);
      Recall_record.read(file_bit , 2);
      display.setFont(Dialog_plain_12);
      display.drawString(5, 0, String(file_bit[0]));
      display.drawString(115, 0, String(file_bit[1]));
      display.drawString(64, 0, String(id));
      //      Serial.println(file_bit[0]);
      //      Serial.println(file_bit[1]);
      display.setTextAlignment(TEXT_ALIGN_LEFT);
      display_chinese(0, 13);
    }
    display.display();
    if ((B || C) && !Close_Button) {
      if (Recall_Chinese) {
        if (B) {
          Recall_record.seek(5 + (id_min + Recall_random_id[id]) * 2);
          Recall_record.write(file_bit[0] + 1);
          Recall_record.close();
        }
        if (C) {
          Recall_record.seek(6 + (id_min + Recall_random_id[id]) * 2);
          Recall_record.write(file_bit[1] + 1);
          Recall_record.close();
        }
        id++;
        if (id == (id_max - id_min + 1)) {
          id = 0;
        }
      }
      Recall_Chinese = !Recall_Chinese;
      Close_Button = true;
    }
    if (A && !Close_Button) {
      Recall_Word_open = false;
      menu_open = true;
      Interface = 0;
      Close_Button = true;
    }
  }
}
void Recite_Word() {
  if (Recite_Word_open) {
    display.clear();
    display.setFont(Dialog_plain_12);
    display.drawString(0, 0, Word(id));
    display_chinese(0, 13);
    display.display();
    if (C && !Close_Button) {
      id++;
      Close_Button = true;
    }
    if (B && !Close_Button) {
      id--;
      Close_Button = true;
    }
    if (id < id_min || id > id_max) {
      main_Interface_open = true;
      Recite_Word_open = false;
    }
    if (A && !Close_Button) {
      Recite_Word_open = false;
      menu_open = true;
      Close_Button = true;
      Interface = 0;
    }
  }
}

void display_str(String str_, byte str_id, char x, char y) {
  uint8_t str_bit[2];
  File menu;
  menu = SPIFFS.open("/" + str_ + ".str" , "r");
  menu.seek(str_id * 21);
  menu.read(str_bit, 1);
  Chinese[0][0] = str_bit[0];
  for (byte Chinese_long = Chinese[0][0]; Chinese_long > 0; Chinese_long--) {
    menu.read(str_bit, 2);
    Chinese[0][Chinese_long] = str_bit[0];
    Chinese[1][Chinese_long] = str_bit[1];
  }
  menu.close();
  display_chinese(x, y);
}
void menu() {
  if (menu_open) {
    random(id_max);
    display.clear();
    display.drawXbm( 20 , -1 , 16 , 16 , arrow );
    display_str("menu", Interface, 40, 0);
    display_str("menu", Interface + 1, 40, 13);
    display_str("menu", Interface + 2, 40, 26);
    //    display_str("menu", Interface + 3, 40, 39);
    display.display();
    if (C && !Close_Button) {
      Interface++;
      Close_Button = true ;

    }
    if (B && !Close_Button) {
      Interface--;
      Close_Button = true;
    }
    if (A && !Close_Button) {
      Close_Button = true;
      switch (Interface) {
        case 0: {
            menu_open = false;
            main_Interface_open = true;
          }
          break;
        case 1: {
            menu_open = false;
            Recall_Word_open = true;
            Recall_random_produce();
            //            for (int i = 0 ; i < 50; i++) {
            //              Serial.println(Recall_random_id[i]);
            //            }
            id = 0;
          }
          break;
      }
    }
  }
}
void loop() {
  if (sleep1 >= sleep2) {
    display.displayOn();
    sleep2 = millis();
    main_Interface();
    Recite_Word();
    Recall_Word();
    menu();
    if (sleep2 >= sleep1) {
      display.displayOff();
    }
  }
  if (A || B || C) {
    Close_Button = true;
  }
  Check_Button();
}
